/*

*/

//this includes the SD card libary that comes with the Arduino
#include &lt;SD.h&gt; 
//this is a library that uses the (16 bit) timer 1 of the arduino to trigger interrupts in certain
#include &lt;TimerOne.h&gt;

time intervals.
//here we use it to read sensor values precisely every 500ms.
#include &lt;SPI.h&gt;

//we are using pin#10 as chip select pin for the SD card
#define chipSelect 10
#define potentiometerSwiperPin 0 //use A0 as sensor input

//this is the variable used in the Interrupt Service Routine (ISR) for &#39;reporting&#39; the
//potentiometer value to the main loop.
volatile float sensorValue;
//this is the variable use in the ISR to record the time when the sensor was readout.
volatile float sensorTime;
//this flag is used to communicate to the main loop that a new value was read.
volatile byte sensorFlag;

void setup()
{
Serial.begin(9600); //start setial port at 9600 baud
Serial.print(&quot;Initializing SD card...&quot;);

pinMode(chipSelect, OUTPUT); //set chip select PIN as output. If you use another pin, apparently #10 needs to
be an output anyway to be able to use the SD.h library.

if (!SD.begin(chipSelect)) { // see if the card is present and can be initialized:
Serial.println(&quot;Card failed, or not present&quot;);
return; //exit the setup function. This quits the setup() and the program counter jumps to the loop().
}
Serial.println(&quot;card initialized.&quot;); //otherwise, tell us that the card was successfully initialized.

9

if (SD.exists(&quot;datalog.txt&quot;)) //if the datalog.txt file is already on the disk
{
SD.remove(&quot;datalog.txt&quot;);//delete it. This prevents that the data is appended to an already existing file.
}
Timer1.initialize(500000); // initialize timer1, and set a 500 ms second period for the interrupt interval 
// (i.e. the ISR will be called
//every 500000 us to read out the potentiometer that simulates a sensor in this tutorial.
Timer1.attachInterrupt(readoutPotentiometer); // attaches the readoutPotentiometer() function as &#39;Interrupt
Service Routine&#39; (ISR) to the timer1 interrupt
//this means that every time 500000 us have passed, the readoutPotentiometer() routine will be called.}
void loop()
{
String dataString = &quot;&quot;;//instantiate (make) an object of the string class for assembling a text line of the datalog
if (sensorFlag == 1) //if there is a sensor reading...
{
dataString = String(sensorTime) + String(&quot;,&quot;) + String(sensorValue); //concatenate (add together) a string
consisting of the time and the sensor reading at that time
//the time and the reading are separated by a &#39;comma&#39;, which acts as the delimiter enabling to read the
datalog.txt file as two columns into
//a spread sheet program like excel.

File dataFile = SD.open(&quot;datalog.txt&quot;, FILE_WRITE);//open a file named datalog.txt. FILE_WRITE mode
specifies to append the string at the end of the file
//file names must adhere to the &quot;8.3 format&quot;(max 8 char in the name, and a 3 char extension)
//if there is no file of that name on the SD card, this .open method will create a new file.
//This line actually instantiates an File object named &quot;datafile&quot;

10
sensorFlag = 0; //reset the sensor reading flag. This prevents the loop from running until a new sensor
reading comes from the ISR.

if (dataFile) { // if the file is available, write to it (&#39;datafile&#39; is returned 1 if SD.open was successful.
dataFile.println(dataString);//print the concatenated data string and finish the line with a carriage return
(println adds the CR automatically after printing the string)
dataFile.close(); 
//close the file. IT is a good idea to always open/close a file before and after writing to it.
//That way, if someone removes the card the file is most
//likely o.k. and can be read with the computer.
Serial.println(dataString);
}

// if SD.open is not successful it returns a 0, i.e. the else{} is executed if the file 
// could not be opened/created successfully.
else {
//in that case print an error message
Serial.println(&quot;error opening datalog.txt&quot;);
}
}
}

void readoutPotentiometer()//this is the ISR routine that is executed everytime the timer1 interrupt is called.
{
sensorValue = analogRead(potentiometerSwiperPin);//read out the potentiometer swiper
sensorValue = ((sensorValue * 5.0) / 1024.0) * 4.25;
sensorTime = 0.001 * millis(); //note the time
sensorFlag = 1; //set the flag that tells the loop() that there is a new sensor value to be printed.
}